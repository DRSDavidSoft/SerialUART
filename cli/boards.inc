/* Generated by tools/import_boards.py; data copyright Edward Wright.
 * MIT notice: data/SIMPLYSERIAL-LICENSE.txt.
 * Source SHA-256: 5b1f7333cd4eda0ea969dc052879b291dcd2c4d56fec8efd99ec29e55aee21ef */
static const sc_board_entry board_data[]={
    {0x0483,0x572A,"STMicroelectronics","NUCLEO-F446RE - CPy"},
    {0x04D8,0xEA2A,"BHDynamics","DynaLoRa_USB"},
    {0x04D8,0xEAD1,"BHDynamics","DynOSSAT-EDU-EPS-v1.0"},
    {0x04D8,0xEAD2,"BHDynamics","DynOSSAT-EDU-OBC-v1.0"},
    {0x04D8,0xEC44,"maholli","PyCubed"},
    {0x04D8,0xEC63,"Kevin Neubauer","CircuitBrains Basic"},
    {0x04D8,0xEC64,"Kevin Neubauer","CircuitBrains Deluxe"},
    {0x04D8,0xEC72,"XinaBox","XinaBox CC03"},
    {0x04D8,0xEC75,"XinaBox","XinaBox CS11"},
    {0x04D8,0xED5F,"Itaca Innovation","uChip CircuitPython"},
    {0x04D8,0xED94,"maholli","kicksat-sprite"},
    {0x04D8,0xEDB3,"Capable Robot Components","Programmable USB Hub"},
    {0x04D8,0xEDBE,"maholli","SAM32"},
    {0x04D8,0xEE8C,"J&J Studios","datum-Distance"},
    {0x04D8,0xEE8D,"J&J Studios","datum-IMU"},
    {0x04D8,0xEE8E,"J&J Studios","datum-Light"},
    {0x04D8,0xEE8F,"J&J Studios","datum-Weather"},
    {0x04D8,0xEF67,"senseBox","senseBox MCU"},
    {0x04E9,0x80FF,"PCTEL","WSC-1450"},
    {0x054C,0x0BC2,"Sony","Spresense"},
    {0x0B6A,0x003C,"Analog Devices","MAX32690 APARD"},
    {0x0B6A,0x003D,"Analog Devices","MAX32690 EvKit"},
    {0x1209,0x0001,"Solder Party","ESP32-P4 Stamp XL"},
    {0x1209,0x2017,"Benjamin Shockley","Mini SAM M4"},
    {0x1209,0x2023,"Lilygo","T-Display"},
    {0x1209,0x2031,"Czech maker","ES3ink"},
    {0x1209,0x3141,"CrumpSpace","CrumpS2"},
    {0x1209,0x3252,"Targett","Targett Module Clip w/Wroom"},
    {0x1209,0x3253,"Targett","Targett Module Clip w/Wrover"},
    {0x1209,0x4203,"42. Keebs","Frood"},
    {0x1209,0x4D43,"Robotics Masters","Robo HAT MM1 M4"},
    {0x1209,0x4DDD,"Oak Dev Tech","CP Sapling"},
    {0x1209,0x4DDE,"Oak Dev Tech","CP Sapling M0 w/ SPI Flash"},
    {0x1209,0x4DDF,"Oak Dev Tech","CP Sapling Rev B"},
    {0x1209,0x4DF0,"Oak Dev Tech","Pixelwing ESP32S2"},
    {0x1209,0x4DF1,"Oak Dev Tech","BREAD2040"},
    {0x1209,0x4DF2,"Oak Dev Tech","CAST AWAY RP2040"},
    {0x1209,0x4DF6,"Oak Dev Tech","RPGA Feather"},
    {0x1209,0x5687,"Bradán Lane STUDIO","Coin M0"},
    {0x1209,0x5A52,"ZRichard","RP2.65-F"},
    {0x1209,0x5BF0,"Foosn","Fomu"},
    {0x1209,0x6036,"Weekin","WK-50"},
    {0x1209,0x7150,"Electronic Cats","Hunter Cat NFC"},
    {0x1209,0x7382,"Invector Labs AB","iLabs Challenger 840"},
    {0x1209,0x805A,"Electronic Cats","BastBLE"},
    {0x1209,0x8CAE,"takayoshiotake","Octave RP2040"},
    {0x1209,0x9000,"Hack Club","Sprig"},
    {0x1209,0xA182,"Solder Party","RP2040 Stamp"},
    {0x1209,0xA183,"Solder Party","RP2350 Stamp"},
    {0x1209,0xA184,"Solder Party","RP2350 Stamp XL"},
    {0x1209,0xADF0,"ICBbuy","SuperMini NRF52840"},
    {0x1209,0xB182,"Solder Party","BBQ20 Keyboard"},
    {0x1209,0xBAB0,"Electronic Cats","Bast WiFi"},
    {0x1209,0xBAB1,"Electronic Cats","Meow Meow"},
    {0x1209,0xBAB2,"Electronic Cats","CatWAN USBStick"},
    {0x1209,0xBAB3,"Electronic Cats","Bast Pro Mini M0"},
    {0x1209,0xBAB6,"Electronic Cats","Escornabot Makech"},
    {0x1209,0xBAB8,"Electronic Cats","NFC Copy Cat"},
    {0x1209,0xC051,"Betrusted","Simmel"},
    {0x1209,0xCB65,"0xCB","Gemini"},
    {0x1209,0xCB74,"0xCB","Helios"},
    {0x1209,0xD10D,"Diodes Delight","Piunora"},
    {0x1209,0xD1B5,"Radomir Dopieralski","PewPew LCD"},
    {0x1209,0xD1B6,"Radomir Dopieralski","uGame22"},
    {0x1209,0xE3E3,"StackRduino","StackRduino M0 PRO"},
    {0x1209,0xEF00,"2231puppy","E-Fidget"},
    {0x1209,0xF123,"Electrolama","minik"},
    {0x1209,0xF500,"Silicognition","M4-Shim"},
    {0x1209,0xF502,"Silicognition","RP2040-Shim"},
    {0x1209,0xFD42,"HXR.DK","SAO Digital Multimeter"},
    {0x1209,0xFF40,"RF.Guru","RF.Guru RP2040"},
    {0x1354,0x4004,"FACTS Engineering","P1AM-200 CircuitPython"},
    {0x16D0,0x07F2,"Autosport Labs","Autosport Labs ESP32-CAN-X2"},
    {0x16D0,0x08C6,"Pimoroni","Keybow 2040"},
    {0x16D0,0x08C7,"Pimoroni","Tiny 2040 (8MB)"},
    {0x16D0,0x08C8,"Pimoroni","PicoSystem"},
    {0x16D0,0x10ED,"Mechwild","PillBug"},
    {0x1915,0xB001,"Makerdiary","Pitaya Go"},
    {0x192F,0xB1B2,"WarmBit","WarmBit BluePixel nRF52840"},
    {0x1B4F,0x0015,"SparkFun","RedBoard Turbo Board"},
    {0x1B4F,0x0016,"SparkFun","SparkFun  SAMD51 Thing+"},
    {0x1B4F,0x0017,"SparkFun","LUMIDrive Board"},
    {0x1B4F,0x0020,"SparkFun","SparkFun MicroMod SAMD51 Processor"},
    {0x1B4F,0x0021,"SparkFun","SparkFun MicroMod nRF52840 Processor"},
    {0x1B4F,0x0024,"SparkFun","SparkFun MicroMod RP2040 Processor"},
    {0x1B4F,0x0025,"SparkFun","Thing Plus RP2040"},
    {0x1B4F,0x0026,"SparkFun","Pro Micro RP2040"},
    {0x1B4F,0x0027,"SparkFun","SparkFun STM32 MicroMod Processor"},
    {0x1B4F,0x0028,"SparkFun","Thing Plus - STM32"},
    {0x1B4F,0x002E,"SparkFun","Teensy MicroMod"},
    {0x1B4F,0x0038,"SparkFun","Thing Plus RP2350"},
    {0x1B4F,0x0039,"SparkFun","Pro Micro RP2350"},
    {0x1B4F,0x5289,"SparkFun","SFE_nRF52840_Mini"},
    {0x1B4F,0x8D22,"SparkFun","SparkFun SAMD21 Mini Breakout"},
    {0x1B4F,0x8D23,"SparkFun","SparkFun SAMD21 Dev Breakout"},
    {0x1B4F,0x8D24,"SparkFun","SparkFun Qwiic Micro"},
    {0x1D50,0x60E8,"Radomir Dopieralski","PewPew M4"},
    {0x1D50,0x6152,"JPConstantineau","BlueMicro833"},
    {0x1D50,0x6153,"JPConstantineau","PyKey44"},
    {0x1D50,0x6154,"JPConstantineau","EncoderPad RP2040"},
    {0x1D50,0x6161,"JPConstantineau","BlueMicro840"},
    {0x2019,0x7103,"Benjamin Shockley","Fig Pi"},
    {0x2341,0x056B,"Arduino","Arduino Nano ESP32"},
    {0x2341,0x8053,"Arduino","Arduino MKR1300"},
    {0x2341,0x8057,"Arduino","Arduino Nano 33 IoT"},
    {0x2341,0x805A,"Arduino","Arduino_Nano_33_BLE"},
    {0x2341,0x824D,"Arduino","Arduino Zero"},
    {0x239A,0x006A,"WeAct","stm32f411ce blackpill with flash"},
    {0x239A,0x00CC,"Adafruit","QT Py M0 Haxpress"},
    {0x239A,0x00CF,"Arduino","Arduino Nano RP2040 Connect"},
    {0x239A,0x0145,"Adafruit","Metro ESP32-S3"},
    {0x239A,0x102E,"WeAct Studio","Pico"},
    {0x239A,0x2030,"Czech maker","Maker badge"},
    {0x239A,0x6005,"Winterbloom","Big Honking Button"},
    {0x239A,0x8009,"ATMegaZero","ATMegaZero ESP32-S2"},
    {0x239A,0x8012,"Adafruit","ItsyBitsy M0 Express"},
    {0x239A,0x8014,"Adafruit","Metro M0 Express"},
    {0x239A,0x8015,"Adafruit","Feather M0"},
    {0x239A,0x8019,"Adafruit","CircuitPlayground Express"},
    {0x239A,0x801D,"Adafruit","Gemma M0"},
    {0x239A,0x801F,"Adafruit","Trinket M0"},
    {0x239A,0x8021,"Adafruit","Metro M4 Express"},
    {0x239A,0x8023,"Adafruit","Feather M0 Express"},
    {0x239A,0x8026,"Adafruit","Feather M4 Express"},
    {0x239A,0x802A,"Adafruit","Feather nRF52840 Express"},
    {0x239A,0x802C,"Adafruit","ItsyBitsy M4 Express"},
    {0x239A,0x8030,"Adafruit","Trellis M4 Express"},
    {0x239A,0x8032,"Adafruit","Grand Central M4 Express"},
    {0x239A,0x8034,"Adafruit","PyBadge"},
    {0x239A,0x8036,"Adafruit","PyPortal"},
    {0x239A,0x8038,"Adafruit","Metro M4 Airlift Lite"},
    {0x239A,0x803C,"Electronut Labs","Papyr"},
    {0x239A,0x803E,"Adafruit","PyGamer"},
    {0x239A,0x8040,"Adafruit","Metro nRF52840 Express"},
    {0x239A,0x8046,"Adafruit","Circuit Playground Bluefruit"},
    {0x239A,0x8048,"Adafruit","Monster M4SK"},
    {0x239A,0x804A,"Adafruit","Hallowing M4 Express"},
    {0x239A,0x804C,"Adafruit","PyRuler"},
    {0x239A,0x804E,"keithp.com","snekboard"},
    {0x239A,0x8050,"Arduino","Arduino MKRZero"},
    {0x239A,0x8052,"Adafruit","ItsyBitsy nRF52840 Express"},
    {0x239A,0x8054,"Adafruit","PyPortal Titano"},
    {0x239A,0x8056,"STMicroelectronics","STM32F412ZG Discovery Board - CPy"},
    {0x239A,0x8058,"arturo182","Serpente"},
    {0x239A,0x805A,"Adafruit","Feather STM32F405 Express"},
    {0x239A,0x805C,"George Robotic","Pyboard Version 1.1"},
    {0x239A,0x805E,"STMicroelectronics","STM32F411VE Discovery Board - CPy"},
    {0x239A,0x8060,"Cedar Grove Studios","StringCar M0 Express"},
    {0x239A,0x8062,"Winterbloom","Sol"},
    {0x239A,0x8066,"ndGarage","Bit6"},
    {0x239A,0x8068,"MicroPython Chinese Community","PYB LR Nano V2"},
    {0x239A,0x8069,"Jeremy Gillick","Thunderpack STM32F411"},
    {0x239A,0x806A,"WeAct","stm32f411ce blackpill"},
    {0x239A,0x806C,"@sarfata","shIRtty"},
    {0x239A,0x8070,"Teknikio","Bluebird"},
    {0x239A,0x8071,"Jeremy Gillick","Thunderpack STM32F411"},
    {0x239A,0x8072,"Adafruit","CLUE nRF52840 Express"},
    {0x239A,0x8074,"arturo182","Feather MIMXRT1011"},
    {0x239A,0x8076,"arturo182","Feather MIMXRT1062"},
    {0x239A,0x8078,"NXP","IMXRT1010-EVK"},
    {0x239A,0x807A,"ARAMCON Badge Team","ARAMCON Badge 2019"},
    {0x239A,0x807C,"ARAMCON Badge Team","ARAMCON2 Badge"},
    {0x239A,0x807E,"Oddly Specific Objects","The Open Book Feather"},
    {0x239A,0x8080,"OSHWA","OHS2020 Badge"},
    {0x239A,0x8082,"NXP","iMX RT 1020 EVK"},
    {0x239A,0x8084,"NXP","iMX RT 1060 EVK"},
    {0x239A,0x8086,"PJRC","Teensy 4.0"},
    {0x239A,0x8088,"Adafruit","Feather Bluefruit Sense"},
    {0x239A,0x808A,"STMicroelectronics","STM32F407VG Discovery Board - CPy"},
    {0x239A,0x808E,"Espruino","Espruino Pico"},
    {0x239A,0x8090,"Espruino","Espruino Wifi"},
    {0x239A,0x8092,"Adafruit","Feather M7 1011"},
    {0x239A,0x8094,"IkigaiSense Technologies","IkigaiSense Vita nRF52840"},
    {0x239A,0x8096,"Szymon Klause","UARTLogger II"},
    {0x239A,0x8098,"STMicroelectronics","Nucleo H743ZI - CPy"},
    {0x239A,0x809A,"STMicroelectronics","Nucleo F767ZI - CPy"},
    {0x239A,0x809C,"STMicroelectronics","ST STM32F746G Discovery - CPy"},
    {0x239A,0x809E,"STMicroelectronics","Nucleo F746zg - CPy"},
    {0x239A,0x80A0,"AtelierDuMaker","ADM_B_NRF52840_1"},
    {0x239A,0x80A4,"OpenMV","OpenMV-H7 R1"},
    {0x239A,0x80A6,"Espressif","Saola 1 w/WROVER"},
    {0x239A,0x80A8,"Espressif","Saola 1 w/WROOM"},
    {0x239A,0x80AC,"UnexpectedMaker","FeatherS2"},
    {0x239A,0x80AE,"PJRC","Teensy 4.1"},
    {0x239A,0x80AF,"Radomir Dopieralski","uGame10"},
    {0x239A,0x80B0,"Radomir Dopieralski","Fluff M0"},
    {0x239A,0x80B2,"HiiBot","HiiBot BlueFi"},
    {0x239A,0x80B4,"Nice Keyboards","nice!nano"},
    {0x239A,0x80B6,"Microchip","SAM E54 Xplained Pro"},
    {0x239A,0x80B8,"Zoomax","LoC BeR M4 base board"},
    {0x239A,0x80B9,"ndGarage","Bit6"},
    {0x239A,0x80BC,"Raytac Corporation","MDBT50Q-DB-40"},
    {0x239A,0x80BE,"TinkeringTech","TinkeringTech ScoutMakes Azul"},
    {0x239A,0x80C0,"Adafruit","BLM Badge"},
    {0x239A,0x80C2,"bleeptrack","PicoPlanet"},
    {0x239A,0x80C6,"MicroDev","microS2"},
    {0x239A,0x80C8,"Espressif","Kaluga 1"},
    {0x239A,0x80CA,"Adafruit","Matrix Portal M4"},
    {0x239A,0x80CC,"Adafruit","QT Py M0"},
    {0x239A,0x80CE,"Adafruit","Feather M4 CAN"},
    {0x239A,0x80CF,"Kittenbot","Meowbit"},
    {0x239A,0x80D1,"Adafruit","Feather M0 Express"},
    {0x239A,0x80D2,"Adafruit","Feather M0 RFM69"},
    {0x239A,0x80D3,"Adafruit","Feather M0 Adalogger"},
    {0x239A,0x80D4,"Adafruit","Feather M0 RFM9x"},
    {0x239A,0x80D5,"Radomir Dopieralski","PewPew 10.2"},
    {0x239A,0x80D7,"Electronut Labs","Blip"},
    {0x239A,0x80D8,"Nordic Semiconductor","PCA10100"},
    {0x239A,0x80D9,"Nordic Semiconductor","PCA10059"},
    {0x239A,0x80DA,"Nordic Semiconductor","PCA10056"},
    {0x239A,0x80DB,"TG-Techie","TG-Watch"},
    {0x239A,0x80DC,"makerdiary","nRF52840-MDK"},
    {0x239A,0x80DD,"makerdiary","nRF52840-MDK-Dongle"},
    {0x239A,0x80DE,"Muselab","nanoESP32-S2 w/Wroom"},
    {0x239A,0x80E0,"Adafruit","Metro ESP32S2"},
    {0x239A,0x80E2,"Adafruit","Metro M7 iMX RT1011 AirLift"},
    {0x239A,0x80E6,"Adafruit","MagTag"},
    {0x239A,0x80EC,"Adafruit","Adafruit Feather ESP32S2"},
    {0x239A,0x80EE,"Adafruit","Feather ESP32-S2 Reverse TFT"},
    {0x239A,0x80F0,"Adafruit","NeoPixel Trinkey M0"},
    {0x239A,0x80F2,"Adafruit","Feather RP2040"},
    {0x239A,0x80F4,"Raspberry Pi","Pico"},
    {0x239A,0x80F8,"Adafruit","QT Py RP2040"},
    {0x239A,0x80FA,"Adafruit","FunHouse"},
    {0x239A,0x80FC,"Adafruit","Rotary Trinkey M0"},
    {0x239A,0x80FE,"Adafruit","ItsyBitsy RP2040"},
    {0x239A,0x8100,"Adafruit","NeoKey Trinkey M0"},
    {0x239A,0x8102,"Adafruit","Slide Trinkey M0"},
    {0x239A,0x8104,"Adafruit","ProxLight Trinkey M0"},
    {0x239A,0x8106,"Adafruit","KB2040"},
    {0x239A,0x8108,"Adafruit","Macropad RP2040"},
    {0x239A,0x810A,"Adafruit","QT2040 Trinkey"},
    {0x239A,0x810C,"Raytac Corporation","MDBT50Q-RX Dongle"},
    {0x239A,0x810E,"Adafruit","nRF52840 LED Glasses Driver"},
    {0x239A,0x8110,"Adafruit","Feather ESP32-S2 TFT"},
    {0x239A,0x8112,"Adafruit","Adafruit QT Py ESP32S2"},
    {0x239A,0x8114,"Adafruit","Feather ESP32S3 No PSRAM"},
    {0x239A,0x8118,"Adafruit","Camera"},
    {0x239A,0x811A,"Adafruit","QT Py ESP32S3 no psram"},
    {0x239A,0x811C,"Adafruit","Adafruit Feather ESP32S3 4MB Flash 2MB PSRAM"},
    {0x239A,0x811E,"Adafruit","Feather ESP32-S3 TFT"},
    {0x239A,0x8120,"Raspberry Pi","Pico W"},
    {0x239A,0x8122,"Adafruit","Feather RP2040 Scorpio"},
    {0x239A,0x8124,"Adafruit","Feather ESP32-S3 Reverse TFT"},
    {0x239A,0x8126,"Adafruit","MatrixPortal S3"},
    {0x239A,0x8128,"Adafruit","Feather RP2040 DVI"},
    {0x239A,0x812A,"Adafruit","Feather RP2040 USB Host"},
    {0x239A,0x812C,"Adafruit","Feather RP2040 ThinkInk"},
    {0x239A,0x812E,"Adafruit","Feather RP2040 RFM"},
    {0x239A,0x8130,"Adafruit","Feather RP2040 CAN"},
    {0x239A,0x8132,"Adafruit","Feather RP2040 Prop-Maker"},
    {0x239A,0x8134,"NXP","iMX RT 1050 EVKB"},
    {0x239A,0x8136,"NXP","iMX RT 1040 EVK"},
    {0x239A,0x8138,"NXP","IMXRT1015-EVK"},
    {0x239A,0x813C,"NXP","iMX RT 1060 EVKB"},
    {0x239A,0x813E,"Adafruit","Metro RP2040"},
    {0x239A,0x8142,"Adafruit","Metro M7 iMX RT1011 SD"},
    {0x239A,0x8144,"Adafruit","QT Py ESP32S3 4MB Flash 2MB PSRAM"},
    {0x239A,0x8148,"Adafruit","Qualia-S3-RGB666"},
    {0x239A,0x814C,"Espressif","ESP32-S3-EV-LCD-Board"},
    {0x239A,0x814E,"Adafruit","Metro RP2350"},
    {0x239A,0x8150,"Adafruit","Feather RP2350"},
    {0x239A,0x8152,"Adafruit","Floppsy RP2040"},
    {0x239A,0x8154,"Adafruit","SHT4x Trinkey M0"},
    {0x239A,0x8156,"Adafruit","Pixel Trinkey M0"},
    {0x239A,0x8158,"Adafruit","TRRS Trinkey M0"},
    {0x239A,0x815E,"Adafruit","Feather RP2040 Adalogger"},
    {0x239A,0x8160,"Adafruit","Adafruit Vindie S2"},
    {0x239A,0x8162,"Raspberry Pi","Pico 2 W"},
    {0x239A,0x816C,"Adafruit","Fruit Jam"},
    {0x239A,0xD1ED,"Adafruit","HalloWing M0 Express"},
    {0x2786,0x9207,"Switch Science","BLE-SS dev board Multi Sensor"},
    {0x2786,0x920D,"Switch Science","SSCI ISP1807 Dev Board"},
    {0x2786,0x920F,"Switch Science","SSCI ISP1807 Micro Board"},
    {0x2886,0x002F,"Seeed","Seeeduino XIAO"},
    {0x2886,0x0042,"Seeed","Seeeduino XIAO RP2040"},
    {0x2886,0x0045,"Seeed","Seeed XIAO nRF52840 Sense"},
    {0x2886,0x0058,"Seeed","Seeeduino XIAO RP2350"},
    {0x2886,0x802D,"Seeed","Seeeduino Wio Terminal"},
    {0x2886,0x802F,"Seeed","Seeeduino XIAO KB"},
    {0x2886,0x8056,"Seeed Studio","Seeed Xiao ESP32-S3 Sense"},
    {0x2886,0xF001,"Makerdiary","nRF52840 M.2 Developer Kit"},
    {0x2886,0xF002,"Makerdiary","M60 Keyboard"},
    {0x2886,0xF003,"Makerdiary","Makerdiary nRF52840 Connect Kit"},
    {0x2886,0xF004,"Makerdiary","iMX RT1011 Nano Kit"},
    {0x2B04,0xC00C,"Particle","Argon"},
    {0x2B04,0xC00D,"Particle","Boron"},
    {0x2B04,0xC00E,"Particle","Xenon"},
    {0x2E8A,0x000B,"Raspberry Pi","Pico 2"},
    {0x2E8A,0x1000,"Cytron","Maker Pi RP2040"},
    {0x2E8A,0x1002,"Pimoroni","Pimoroni Pico LiPo (4MB)"},
    {0x2E8A,0x1003,"Pimoroni","Pimoroni Pico LiPo (16MB)"},
    {0x2E8A,0x1005,"Melopero","Shake RP2040"},
    {0x2E8A,0x1006,"Invector Labs","Challenger RP2040 WiFi"},
    {0x2E8A,0x1008,"Pimoroni","PGA2040"},
    {0x2E8A,0x1009,"Pimoroni","Interstate 75"},
    {0x2E8A,0x100A,"Pimoroni","Plasma 2040"},
    {0x2E8A,0x100B,"Invector Labs","Challenger RP2040 LTE"},
    {0x2E8A,0x100D,"Invector Labs","Challenger NB RP2040 WiFi"},
    {0x2E8A,0x100E,"Raspberry Pi","Zero"},
    {0x2E8A,0x100F,"Cytron","Maker Nano RP2040"},
    {0x2E8A,0x1012,"Raspberry Pi","Compute Module 4 IO Board"},
    {0x2E8A,0x1013,"Raspberry Pi","Raspberry Pi 4B"},
    {0x2E8A,0x1014,"Raspberry Pi","Compute Module 4"},
    {0x2E8A,0x1015,"Raspberry Pi","Raspberry Pi Zero 2W"},
    {0x2E8A,0x1016,"Pimoroni","Tiny 2040 (2MB)"},
    {0x2E8A,0x1018,"Pimoroni","Inky Frame 5.7"},
    {0x2E8A,0x1019,"Pimoroni","Motor 2040"},
    {0x2E8A,0x101A,"Pimoroni","Servo 2040"},
    {0x2E8A,0x101B,"Pimoroni","Badger 2040"},
    {0x2E8A,0x101E,"Raspberry Pi","Zero W"},
    {0x2E8A,0x101F,"Waveshare Electronics","RP2040-Zero"},
    {0x2E8A,0x1020,"Waveshare Electronics","RP2040-Plus (4MB)"},
    {0x2E8A,0x1021,"Waveshare Electronics","Waveshare RP2040-LCD-0.96"},
    {0x2E8A,0x1023,"Invector Labs","Challenger RP2040 LoRa"},
    {0x2E8A,0x1026,"ELECFREAKS","Pico:ed"},
    {0x2E8A,0x1027,"WIZnet","W5100S-EVB-Pico"},
    {0x2E8A,0x1028,"WIZnet","WizFi360-EVB-Pico"},
    {0x2E8A,0x1029,"WIZnet","W5500-EVB-Pico"},
    {0x2E8A,0x102C,"Invector Labs","Challenger RP2040 WiFi/BLE"},
    {0x2E8A,0x102D,"Invector Labs","Challenger RP2040 SD/RTC"},
    {0x2E8A,0x102E,"VCC-GND Studio","YD-RP2040"},
    {0x2E8A,0x1032,"Invector Labs","Challenger RP2040 SubGHz"},
    {0x2E8A,0x1039,"Waveshare Electronics","Waveshare RP2040-LCD-1.28"},
    {0x2E8A,0x103A,"Waveshare Electronics","RP2040-One"},
    {0x2E8A,0x1043,"NEWSAN","ARCHI"},
    {0x2E8A,0x1046,"WIZnet","W6100-EVB-Pico"},
    {0x2E8A,0x1048,"nullbits","Bit-C PRO"},
    {0x2E8A,0x104A,"Boardsource","BLOK"},
    {0x2E8A,0x104B,"Datanoise","PicoADK"},
    {0x2E8A,0x104C,"Raspberry Pi","COSMO-Pico"},
    {0x2E8A,0x104F,"Pimoroni","Badger 2040 W"},
    {0x2E8A,0x1056,"Waveshare Electronics","RP2040-GEEK"},
    {0x2E8A,0x1057,"Waveshare Electronics","Waveshare RP2040-TOUCH-LCD-1.28"},
    {0x2E8A,0x1058,"Pimoroni","Plasma 2040 W"},
    {0x2E8A,0x1059,"Pimoroni","Pimoroni Pico DV Demo Base for Pico"},
    {0x2E8A,0x105A,"Pimoroni","Pimoroni Pico DV Demo Base for Pico W"},
    {0x2E8A,0x105E,"Breadstick Innovations","Raspberry Breadstick"},
    {0x2E8A,0x1060,"splitkb.com","Liatris"},
    {0x2E8A,0x1063,"Pajenicko s.r.o","PicoPad"},
    {0x2E8A,0x1067,"WisdPi","Ardu2040M"},
    {0x2E8A,0x106A,"WisdPi","Tiny RP2040"},
    {0x2E8A,0x1071,"Cytron","Maker Uno RP2040"},
    {0x2E8A,0x1072,"Maple Computing","Elite-Pi"},
    {0x2E8A,0x1073,"Bradán Lane STUDIO","Explorer Badge"},
    {0x2E8A,0x1074,"Cytron","Cytron EDU PICO for Pico W"},
    {0x2E8A,0x107D,"HEIA-FR","Picomo V2"},
    {0x2E8A,0x1081,"Pimoroni","Inky Frame 7.3"},
    {0x2E8A,0x1083,"Waveshare Electronics","RP2040-PiZero"},
    {0x2E8A,0x1084,"Waveshare Electronics","RP2040-Tiny"},
    {0x2E8A,0x1093,"Cytron","IRIV IO Controller"},
    {0x2E8A,0x1096,"Cytron","MOTION 2350 Pro"},
    {0x2E8A,0x109A,"Invector Labs","Challenger+ RP2350 WiFi6/BLE5"},
    {0x2E8A,0x109B,"Invector Labs","Challenger+ RP2350 BConnect"},
    {0x2E8A,0x109E,"WIZnet","W5100S-EVB-Pico2"},
    {0x2E8A,0x109F,"WIZnet","W5500-EVB-Pico2"},
    {0x2E8A,0x10A0,"WIZnet","W6100-EVB-Pico2"},
    {0x2E8A,0x10A2,"Pimoroni","Tiny FX"},
    {0x2E8A,0x10A3,"Pimoroni","Pico Plus 2"},
    {0x2E8A,0x10A4,"Pimoroni","Tiny 2350"},
    {0x2E8A,0x10A5,"Pimoroni","Plasma 2350"},
    {0x2E8A,0x10A6,"Pimoroni","PGA2350"},
    {0x2E8A,0x10AE,"Datanoise","PicoADK V2"},
    {0x2E8A,0x10B0,"Waveshare Electronics","RP2350-Zero"},
    {0x2E8A,0x10B1,"Waveshare Electronics","RP2350-Plus"},
    {0x2E8A,0x10B2,"Waveshare Electronics","RP2350-Tiny"},
    {0x2E8A,0x10B3,"Waveshare Electronics","Waveshare RP2350-LCD-1.28"},
    {0x2E8A,0x10B4,"Waveshare Electronics","Waveshare RP2350-TOUCH-LCD-1.28"},
    {0x2E8A,0x10B5,"Waveshare Electronics","RP2350-One"},
    {0x2E8A,0x10B6,"Waveshare Electronics","RP2350-GEEK"},
    {0x2E8A,0x10B7,"Waveshare Electronics","Waveshare RP2350-LCD-0.96"},
    {0x2E8A,0x10BD,"Pimoroni","Pico Plus 2 W"},
    {0x2E8A,0x10BF,"Pimoroni","Plasma 2350 W"},
    {0x2E8A,0x10C1,"Music Thing Modular","Workshop Computer"},
    {0x2E8A,0x10C4,"HEIA-FR","Picomo V3"},
    {0x303A,0x7001,"Espressif","ESP32-S2-HMI-DevKit-1"},
    {0x303A,0x7003,"Espressif","ESP32-S3-DevKitC-1-N8R8"},
    {0x303A,0x7005,"Espressif","ESP32-S3-Box-2.5"},
    {0x303A,0x7007,"Espressif","ESP32-S3-DevKitM-1-N8"},
    {0x303A,0x7009,"Espressif","ESP32-S2-DevKitC-1-N4R2"},
    {0x303A,0x700B,"Espressif","ESP32-S3-USB-OTG-N8"},
    {0x303A,0x700D,"Espressif","ESP32-S3-Box-Lite"},
    {0x303A,0x700F,"Espressif","ESP32-S3-EYE"},
    {0x303A,0x7011,"Espressif","ESP32-S3-EV-LCD-Board_v1.5"},
    {0x303A,0x7013,"Espressif","ESP32-P4-Function-EV"},
    {0x303A,0x8002,"UnexpectedMaker","TinyS2"},
    {0x303A,0x8007,"LILYGO","TTGO T8 ESP32-S2"},
    {0x303A,0x800D,"Gravitech","Cucumber RS"},
    {0x303A,0x80A1,"Gravitech","Cucumber R"},
    {0x303A,0x80A4,"Gravitech","Cucumber M"},
    {0x303A,0x80A7,"Gravitech","Cucumber MS"},
    {0x303A,0x80AA,"Espressif","Franzininho WIFI w/Wroom"},
    {0x303A,0x80AD,"Espressif","Franzininho WIFI w/Wrover"},
    {0x303A,0x80AF,"Artisense","Reference Design RD00"},
    {0x303A,0x80B2,"Muselab","nanoESP32-S2  w/Wrover"},
    {0x303A,0x80B5,"UnexpectedMaker","FeatherS2 Neo"},
    {0x303A,0x80B7,"MORPHEANS","MORPHESP-240"},
    {0x303A,0x80C3,"Lolin","S2 Mini"},
    {0x303A,0x80C6,"Lolin","S2 Pico"},
    {0x303A,0x80C8,"BrainBoardz","Neuron"},
    {0x303A,0x80D1,"UnexpectedMaker","TinyS3"},
    {0x303A,0x80D4,"UnexpectedMaker","ProS3"},
    {0x303A,0x80D7,"UnexpectedMaker","FeatherS3"},
    {0x303A,0x80D9,"FutureKeys","HexKy_S2"},
    {0x303A,0x80DD,"CircuitArt","ZeroS3"},
    {0x303A,0x80E0,"BananaPi","BPI-Leaf-S3"},
    {0x303A,0x80E6,"BananaPi","BPI-Bit-S2"},
    {0x303A,0x80E8,"HiiBot","HiiBot IoTs2"},
    {0x303A,0x80EA,"LILYGO","TTGO T8 ESP32-S2-WROOM"},
    {0x303A,0x80ED,"LILYGO","TTGO T8 ESP32-S2"},
    {0x303A,0x80F9,"Cytron","Cytron Maker Feather AIoT S3"},
    {0x303A,0x80FC,"Espressif","MixGo CE"},
    {0x303A,0x80FD,"Espressif","MixGo CE"},
    {0x303A,0x810A,"Waveshare Electronics","ESP32-S2-Pico"},
    {0x303A,0x810C,"Waveshare Electronics","ESP32-S2-Pico-LCD"},
    {0x303A,0x8111,"Smart Bee Designs","Bee-S3"},
    {0x303A,0x8114,"Smart Bee Designs","Bee-Motion-S3"},
    {0x303A,0x8117,"WEMOS","LOLIN S3 16MB Flash 8MB PSRAM"},
    {0x303A,0x811A,"M5Stack","M5Stack Core S3"},
    {0x303A,0x8120,"M5Stack","M5Stack AtomS3"},
    {0x303A,0x812C,"BananaPi","BPI-PicoW-S3"},
    {0x303A,0x813F,"LILYGO","T-Display S3"},
    {0x303A,0x8142,"Turkish Technology Team Foundation","Deneyap Mini"},
    {0x303A,0x8145,"Turkish Technology Team Foundation","Deneyap Mini v2"},
    {0x303A,0x8148,"Turkish Technology Team Foundation","Deneyap Kart 1A v2"},
    {0x303A,0x8151,"LILYGO","TEMBED ESP32S3"},
    {0x303A,0x815D,"Smart Bee Designs","Bee-Data-Logger"},
    {0x303A,0x815F,"M5Stack","M5Stack AtomS3 Lite"},
    {0x303A,0x8162,"WEMOS","LOLIN S3 PRO 16MB Flash 8MB PSRAM"},
    {0x303A,0x8166,"VCC-GND","YD-ESP32-S3"},
    {0x303A,0x8168,"WEMOS","LOLIN S3 MINI 4MB Flash 2MB PSRAM"},
    {0x303A,0x816B,"M5STACK","M5Stack StampS3 - CircuitPython"},
    {0x303A,0x817A,"UnexpectedMaker","NanoS3"},
    {0x303A,0x817D,"UnexpectedMaker","BlizzardS3"},
    {0x303A,0x8180,"UnexpectedMaker","BLING!"},
    {0x303A,0x8187,"M5Stack","M5Stack AtomS3U"},
    {0x303A,0x81A3,"Waveshare Electronics","ESP32-S3-Pico"},
    {0x303A,0x81AA,"MakerM0","MagiClick S3 n4r2"},
    {0x303A,0x81B1,"UnexpectedMaker","TinyWATCH S3"},
    {0x303A,0x81B4,"Waveshare Electronics","Waveshare ESP32-S3-Zero"},
    {0x303A,0x81B6,"LILYGO","T-Deck (Plus)"},
    {0x303A,0x81B9,"Espressif","senseBox MCU-S2 ESP32S2"},
    {0x303A,0x81BF,"MakerFabs","MakerFabs-ESP32-S3-Parallel-TFT-With-Touch-7inch"},
    {0x303A,0x81CF,"Flipper Devices","Flipper Zero Wi-Fi Dev"},
    {0x303A,0x81D0,"Double Take Labs","COLUMBIA-DSL-SENSOR-BOARD-V1"},
    {0x303A,0x81DA,"M5STACK","M5Stack Cardputer - CircuitPython"},
    {0x303A,0x81DD,"M5Stack","M5stack - Dial"},
    {0x303A,0x81EA,"Waveshare Electronics","ESP32-S3-GEEK"},
    {0x303A,0x81F8,"Waveshare Electronics","ESP32-S3-Tiny"},
    {0x303A,0x81FC,"UnexpectedMaker","FeatherS3 Neo"},
    {0x303A,0x81FF,"UnexpectedMaker","RGB Touch Mini"},
    {0x303A,0x8204,"ThingPulse","ThingPulse Pendrive S3"},
    {0x303A,0x8211,"LILYGO","T-Display S3 Pro"},
    {0x303A,0x8217,"WEMOS","LOLIN S3 MINI PRO 4MB Flash 2MB PSRAM"},
    {0x303A,0x821C,"LILYGO","T-Watch-S3"},
    {0x303A,0x8225,"UnexpectedMaker","OMGS3"},
    {0x303A,0x8244,"Fablab Barcelona","Barduino 4.0.2"},
    {0x303A,0x826E,"Waveshare Electronics","Waveshare ESP32-S3-Matrix"},
    {0x303A,0x82A7,"Waveshare Electronics","ESP32-S3-ETH"},
    {0x303A,0x82C2,"LILYGO","T-Dongle S3"},
    {0x303A,0x82C4,"Unknown","ESP32-S2-WROOM"},
    {0x303A,0x82C9,"Heltec","Vision Master E290"},
    {0x30A4,0x0002,"Blues Wireless","Swan R5"},
    {0x3171,0x0101,"8086 Consultancy","Commander"},
    {0x3171,0x010C,"8086 Consultancy","USB Interposer"},
    {0x3171,0x010D,"8086 Consultancy","RP2040 Interfacer"},
    {0x31E2,0x2011,"BDMICRO","VINA-D51"},
    {0x31E2,0x2021,"BDMICRO","VINA-D51"},
    {0x32BD,0x3001,"Alorium Technology","AloriumTech Evo M51"},
    {0x3343,0x83CF,"DFRobot","Firebeetle 2 ESP32-S3"},
    {0x4097,0x0001,"TG-Boards","Datalore IP M4"},
    {0x612B,0x80A7,"Ai-Thinker","ESP 12k NodeMCU"},
};
static const sc_vendor_entry vendor_data[]={
    {0x04D8,"Microchip Technology"},
    {0x054C,"Sony"},
    {0x1209,"Generic"},
    {0x1915,"Nordic Semiconductor"},
    {0x1B4F,"Sparkfun"},
    {0x2341,"Arduino"},
    {0x239A,"Adafruit"},
    {0x2786,"Switch Science, Inc."},
    {0x2886,"Seeed"},
    {0x2B04,"Spark Labs, Inc."},
    {0x2E8A,"Raspberry Pi"},
    {0x303A,"Espressif"},
    {0x30A4,"Blues Wireless"},
    {0x3171,"8086 Consultancy"},
    {0x31E2,"BDMICRO"},
    {0x32BD,"Alorium Technology, LLC"},
};
